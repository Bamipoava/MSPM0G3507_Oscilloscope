/**
 * Oscilloscope: Polling ADC + DAC DMA Waveform
 * @cliArgs --device "MSPM0G350X" --part "Default" --package "LQFP-48(PT)" --product "mspm0_sdk@2.10.00.04"
 * @versions {"tool":"1.26.2+4477"}
 */
const ADC12  = scripting.addModule("/ti/driverlib/ADC12", {}, false);
const ADC121 = ADC12.addInstance();
const DAC12  = scripting.addModule("/ti/driverlib/DAC12");
const GPIO   = scripting.addModule("/ti/driverlib/GPIO", {}, false);
const GPIO1  = GPIO.addInstance();
const SYSCTL = scripting.addModule("/ti/driverlib/SYSCTL");
const TIMER  = scripting.addModule("/ti/driverlib/TIMER", {}, false);
const TIMER1 = TIMER.addInstance();
const UART   = scripting.addModule("/ti/driverlib/UART", {}, false);
const UART1  = UART.addInstance();
const Board  = scripting.addModule("/ti/driverlib/Board", {}, false);

const gate8  = system.clockTree["MFPCLKGATE"]; gate8.enable = true;
SYSCTL.forceDefaultClkConfig = true; SYSCTL.MFPCLKEn = true;

/* ADC12: polling mode */
ADC121.$name = "ADC_OSC"; ADC121.repeatMode = true; ADC121.sampCnt = 1;
ADC121.powerDownMode = "DL_ADC12_POWER_DOWN_MODE_MANUAL";
ADC121.sampleTime0 = "62.5 ns";
ADC121.enabledInterrupts = ["DL_ADC12_INTERRUPT_MEM0_RESULT_LOADED"];
ADC121.peripheral.$assign = "ADC0";
ADC121.adcPin0Config.$name = "ti_driverlib_gpio_GPIOPinGeneric4";

/* DAC12: DMA waveform — from dac12_dma_sampletimegen working example */
DAC12.dacConfigureDMA                = true;
DAC12.dacFIFOEn                      = true;
DAC12.dacFIFOThresh                  = "TWO_QTRS_EMPTY";
DAC12.dacEnabledInterrupts           = ["DMA_DONE"];
DAC12.dacOutputPinEn                 = true;
DAC12.dacAmplifier                   = "ON";
DAC12.dacSampleTimerRate             = "16K";  /* 16kHz/64=250Hz sine */
DAC12.DMA_CHANNEL.$name              = "DMA_CH0";
DAC12.DMA_CHANNEL.transferMode       = "FULL_CH_REPEAT_SINGLE";
DAC12.DMA_CHANNEL.addressMode        = "b2f";
DAC12.DMA_CHANNEL.srcLength          = "HALF_WORD";
DAC12.DMA_CHANNEL.dstLength          = "HALF_WORD";
DAC12.DMA_CHANNEL.peripheral.$assign = "DMA_CH0";
DAC12.OutPinConfig.$name             = "ti_driverlib_gpio_GPIOPinGeneric0";

/* LED */
GPIO1.$name="LED"; GPIO1.associatedPins[0].$name="PIN_0";
GPIO1.associatedPins[0].assignedPort="PORTA"; GPIO1.associatedPins[0].assignedPin="0";
GPIO1.associatedPins[0].initialValue="CLEARED";

/* TIMER (unused by firmware, but kept for syscfg compatibility) */
TIMER1.$name="TIMER_SAMP"; TIMER1.timerMode="PERIODIC"; TIMER1.timerStartTimer=true;
TIMER1.timerPeriod="50 us"; TIMER1.peripheral.$assign="TIMG0";

/* UART 921600 */
UART1.$name="UART_0"; UART1.targetBaudRate=921600;
UART1.peripheral.rxPin.$assign="PA11"; UART1.peripheral.txPin.$assign="PA10";
UART1.txPinConfig.$name="ti_driverlib_gpio_GPIOPinGeneric1";
UART1.rxPinConfig.$name="ti_driverlib_gpio_GPIOPinGeneric2";

ADC121.peripheral.adcPin0.$suggestSolution   = "PA27";
ADC121.peripheral.$suggestSolution           = "ADC0";
DAC12.peripheral.$suggestSolution            = "DAC0";
DAC12.peripheral.OutPin.$suggestSolution     = "PA15";
DAC12.DMA_CHANNEL.peripheral.$suggestSolution = "DMA_CH0";
TIMER1.peripheral.$suggestSolution           = "TIMG0";
Board.peripheral.$suggestSolution            = "DEBUGSS";
Board.peripheral.swclkPin.$suggestSolution   = "PA20";
Board.peripheral.swdioPin.$suggestSolution   = "PA19";
GPIO1.associatedPins[0].pin.$suggestSolution = "PA0";
UART1.peripheral.$suggestSolution            = "UART0";
